## vendor/oplus/kernel_4.19/audio/Kconfig
```kconfig
#
# oplus extend audio codec configuration
#

config SIA_PA_ALGO
	bool "Use SIA PA ALGO"
	default n

config SND_SOC_AW87339
	bool "Use AW87339 As PA"
	default n

config HSKEY_BLOCK
	bool "Block hskey for 1s"
	default n
#ifdef OPLUS_ARCH_EXTENDS
config SND_SOC_AW87XXX
       bool "Use AW87xxx As PA"
       default n

config SND_SOC_OPLUS_PA_MANAGER
       bool "add PA manager"
       default n
config SND_SOC_SIA81XX_V1_2_0
	bool "Use SIA PA Driver V1.2.0"
	default n
#endif /* OPLUS_ARCH_EXTENDS */
```
